## package/efl/Config.in
```kconfig
menuconfig BR2_PACKAGE_EFL
	bool "Enlightenment Fundation Libraries (EFL)"
	help
	  Support for EFL libraries.

	  http://www.enlightenment.org/

if BR2_PACKAGE_EFL

	source "package/efl/eina/Config.in"
	source "package/efl/evas/Config.in"
	source "package/efl/ecore/Config.in"
	source "package/efl/eet/Config.in"
	source "package/efl/embryo/Config.in"
	source "package/efl/edje/Config.in"

endif
```

## package/efl/ecore/Config.in
```kconfig
config BR2_PACKAGE_ECORE
	bool "ecore"
	select BR2_PACKAGE_EINA
	select BR2_PACKAGE_EVAS
	help
	  ECORE EFL library

if BR2_PACKAGE_ECORE

config BR2_PACKAGE_ECORE_ENABLE-G-MAIN-LOOP
	bool "enable g-main-loop"
	help
	   Enable ecore_main_loop based on g_main_loop

endif
```

## package/efl/edje/Config.in
```kconfig
config BR2_PACKAGE_EDJE
	bool "edje"
	select BR2_PACKAGE_LUA
	select BR2_PACKAGE_LUA_SHARED_LIBRARY
	select BR2_PACKAGE_FONTCONFIG
	select BR2_PACKAGE_FREETYPE
	select BR2_PACKAGE_EINA
	select BR2_PACKAGE_EVAS
	select BR2_PACKAGE_EET
	select BR2_PACKAGE_EMBRYO
	select BR2_PACKAGE_ECORE
	help
	  EDJE EFL library


if BR2_PACKAGE_EDJE

config BR2_PACKAGE_EDJE_AMALGAMATION
	bool "edje amalgamation"
	help
	  Enable generation of one single file with all source
	  code in it, helps compiler optimizations.

endif
```

## package/efl/eet/Config.in
```kconfig
config BR2_PACKAGE_EET
	bool "eet"
	select BR2_PACKAGE_ZLIB
	select BR2_PACKAGE_EINA
	help
	  EET EFL library

if BR2_PACKAGE_EET

config BR2_PACKAGE_EET_TESTS
	bool "eet tests"
	help
	   EET EFL library enable tests

config BR2_PACKAGE_EET_EXAMPLES
	bool "eet examples"
	help
	   EET EFL library enable building examples

config BR2_PACKAGE_EET_COVERAGE
	bool "eet coverage"
	help
	   EET EFL library enable coverage profiling instrumentation

endif
```

## package/efl/eina/Config.in
```kconfig
config BR2_PACKAGE_EINA
	bool "eina"
	help
	  EINA EFL library

if BR2_PACKAGE_EINA

config BR2_PACKAGE_EINA_TESTS
	bool "eina tests"
	help
	   Enable EINA tests

config BR2_PACKAGE_EINA_COVERAGE
	bool "eina coverage"
	help
	   Enable EINA coverage profiling instrumentation

config BR2_PACKAGE_EINA_BENCHMARK
	bool "eina benchmark"
	help
	   Enable EINA benchmarking

endif
```

## package/efl/elementary/Config.in
```kconfig
config BR2_PACKAGE_ELEMENTARY
	bool "elementary"
	select BR2_PACKAGE_EDJE
	help
	  Elementary EFL library
```

## package/efl/embryo/Config.in
```kconfig
config BR2_PACKAGE_EMBRYO
	bool "embryo"
	select BR2_PACKAGE_EINA
	help
	  EMBRYO EFL library
```

## package/efl/evas/Config.in
```kconfig
config BR2_PACKAGE_EVAS
	bool "evas"
	select BR2_PACKAGE_FREETYPE
	select BR2_PACKAGE_EINA
	help
	  EVAS EFL library

if BR2_PACKAGE_EVAS

config BR2_PACKAGE_EVAS_EXAMPLES
	bool "evas examples"
	help
	  EVAS EFL library exmaples

endif
```

## package/htop/Config.in
```kconfig
config BR2_PACKAGE_HTOP
	bool "htop"
	help
	  An interactive process viewer for Linux.

	  http://htop.sourceforge.net/
```

## package/multimedia/fmtools/Config.in
```kconfig
config BR2_PACKAGE_FMTOOLS
	bool "fmtools"
	help
	  Command line programs to control FM radio receivers through V4L2.

	  http://benpfaff.org/fmtools/
```

## package/multimedia/libao/Config.in
```kconfig
config BR2_PACKAGE_LIBAO
	bool "libao"
	help
	  Cross-platform library for audio output.

	  The simple API of libao allows samples to be pushed (blocking writes),
	  as opposed to the pull (callback) nature of SDL's sound API. This can
	  simplify the porting of some applications significantly.
```

## package/pygame/Config.in
```kconfig
config BR2_PACKAGE_PYGAME
	bool "pygame"
	select BR2_PACKAGE_PYTHON
	help
	  Pygame is a set of Python modules designed for writing video games.
	  Pygame adds functionality on top of the excellent SDL library.
	  This allows you to create fully featured games and multimedia programs in the python language.

	  http://pygame.org
```

## package/yawn/Config.in
```kconfig
config BR2_PACKAGE_YAWN
	bool "yawn"
	help
	  Yet Another Watchdog Nudger.
	  Minimal user space part of a watchdog implementation.
	  It activates the watchdog driver and then periodically kicks it,
	  to let it know the system is still operational.
	  If no kicks are received for a while, the driver resets the system.

	  https://github.com/Ayla-/yawn
```

## target/device/opendingux/Config.in
```kconfig
menuconfig BR2_TARGET_OPENDINGUX
	bool "OpenDingux"
	help
	  A Linux distro for handheld game/media players.

	  If the target devices that you want to select does not appear, please
	  select the right architecture and subarchitecture first.

if BR2_TARGET_OPENDINGUX

choice
	prompt "Target device"
	default BR2_TARGET_OPENDINGUX_A320
	help
	  Selects the device to build OpenDingux for.

config BR2_TARGET_OPENDINGUX_A320
	bool "Dingoo A320/A330"
	depends on BR2_mipsel && BR2_mips_jz4740
	help
	  OpenDingux on the Dingoo Digital A320 and Dingoo Technology A330.

endchoice

endif
```
